// SPDX-License-Identifier: (GPL-2.0+ OR MIT)
/*
 * DT-overlay to run the PCIe3_4L Dual Mode controller in Endpoint mode
 * in the SRNS (Separate Reference Clock No Spread) configuration.
 *
 */

/dts-v1/;
/plugin/;

&pcie30phy {
	rockchip,rx-common-refclk-mode = <0 0 0 0>;
};

&pcie3x4 {
	status = "disabled";
};

&pcie3x4_ep {
	vpcie3v3-supply = <&vcc_3v3_m2_a>;
	num-lanes = <1>;
	status = "okay";
	max-link-speed = <2>;
};
